VERSION ""

NS_ :

BS_:

BU_: DRIVER MOTOR

BO_ 200 MOTOR_CMD: 4 DRIVER
 SG_ Get_PWM_Count : 0|16@1+ (1,0) [0|0] "" MOTOR
 SG_ jigar : 17|1@1+ (1,0) [1|1] "" MOTOR
